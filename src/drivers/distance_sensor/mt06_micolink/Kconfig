## src/drivers/distance_sensor/mt06_micolink/Kconfig
```kconfig
menuconfig DRIVERS_DISTANCE_SENSOR_MT06_MICOLINK
	bool "mt06_micolink"
	default n
	---help---
		Enable support for MT-06 Micolink laser rangefinder.
```

## src/modules/px4_simulink_app/Kconfig
```kconfig
menuconfig MODULES_PX4_SIMULINK_APP
	bool "px4_simulink_app"
	default n
	---help---
		Enable support for px4_simulink_app

menuconfig USER_PX4_SIMULINK_APP
	bool "px4_simulink_app running as userspace module"
	default n
	depends on BOARD_PROTECTED && MODULES_PX4_SIMULINK_APP
	---help---
		Put px4_simulink_app in userspace memory
 
```
